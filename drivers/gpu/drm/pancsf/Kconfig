## drivers/gpu/drm/pancsf/Kconfig
```kconfig
# SPDX-License-Identifier: GPL-2.0

config DRM_PANCSF
	tristate "PanCSF (DRM support for ARM Mali CSF-based GPUs)"
	depends on DRM
	depends on ARM || ARM64 || (COMPILE_TEST && !GENERIC_ATOMIC64)
	depends on MMU
	select DRM_SCHED
	select IOMMU_SUPPORT
	select IOMMU_IO_PGTABLE_LPAE
	select DRM_GEM_SHMEM_HELPER
	select PM_DEVFREQ
	select DEVFREQ_GOV_SIMPLE_ONDEMAND
	help
	  DRM driver for ARM Mali CSF-based GPUs.
```
